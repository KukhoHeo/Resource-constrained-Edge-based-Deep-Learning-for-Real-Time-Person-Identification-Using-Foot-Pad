;
; Copyright (c) 2009 Sung Ho Park
;
; SPDX-License-Identifier: Apache-2.0
;

; --------------------------------------------------------------------------------

print "begin"

; --------------------------------------------------------------------------------
; initialize and start the debugger

RESet
SYStem.RESet
SYStem.CPU STM32F769NI
SYStem.CONFIG.DEBUGPORTTYPE SWD
IF hardware.COMBIPROBE()||hardware.UTRACE()
(
  SYStem.CONFIG.CONNECTOR MIPI20T
)
SYStem.Option DUALPORT ON
SYStem.MemAccess DAP
SYStem.JtagClock CTCK 10MHz
Trace.TraceCLOCK 100.0MHz
Trace.DISable
SYStem.Up

; --------------------------------------------------------------------------------
; initialize OFFCHIP trace (ETM, ITM)
IF COMBIPROBE()||UTRACE()||Analyzer()
(
  ; set PinMux and enable Clocks
  Data.Set AD:0xe0042004 %Long Data.Long(E:0xe0042004)|0xe0 ; DBGMCU_CR
  ; set PinMux for PE2-6 -AF0
  Data.Set AD:0x40023810 %Long Data.Long(E:0x40023810)&~0x10      ; RCC_AHB1RST
  Data.Set AD:0x40023830 %Long Data.Long(E:0x40023830)|0x10       ; RCC_AHB1ENR
  Data.Set AD:0x40021000 %Long Data.Long(E:0x40021000)|0x00002aa0 ; GPIOE_MODER
  Data.Set AD:0x40021008 %Long Data.Long(E:0x40021008)|0x00003ff0 ; GPIOE_OSPEEDR
  Data.Set AD:0x40021020 %Long Data.Long(E:0x40021020)&0xf00000ff ; GPIOE_AFRL

  TPIU.PortSize 4
  TPIU.PortMode Continuous
  ITM.DataTrace CorrelatedData
  ITM.ON
  ETM.Trace ON
  ETM.ON
)
IF COMBIPROBE()||UTRACE()
(
  Trace.METHOD CAnalyzer
  Trace.AutoInit ON
  IF CAnalyzer.FEATURE(TPIU.TERMINATION)
  (
    ; pins have limited output current with low supply voltage -> disable Termination
    ;Trace.TERMination OFF
  )
;   Trace.AutoFocus
)
IF Analyzer()
(
  Trace.METHOD Analyzer
  Trace.AutoInit ON
  Trace.AutoFocus
)

; --------------------------------------------------------------------------------
; Flash programming

FLASH.RESet
FLASH.Create 1. 0x08000000--0x0801FFFF  0x8000 TARGET Byte 0. /AutoInc   ; sector 0..3
FLASH.Create 1. 0x08020000--0x0803FFFF 0x20000 TARGET Byte 4.
FLASH.Create 1. 0x08040000--0x0807FFFF 0x40000 TARGET Byte 5.
FLASH.Create 1. 0x08080000--0x080FFFFF 0x40000 TARGET Byte 6. /AutoInc   ; sector 6..7
FLASH.Create 1. 0x08100000--0x081FFFFF 0x40000 TARGET Byte 8. /AutoInc   ; sector 8..11

FLASH.CreateALIAS 0x00200000++0x001FFFFF 0x08000000

FLASH.TARGET 0x20000000 EAHB:0x20001000 0x2000 ~~~~/flash_writer.elf /DualPort

; ReProgram Flash
FLASH.ReProgram ALL
Data.LOAD.Elf ~~~~/app.elf
FLASH.ReProgram OFF

; --------------------------------------------------------------------------------

Register.Set PC Reset_Handler

Break.Set main
Mode.Hll
SYStem.Option.IMASKASM ON
SYStem.Option.IMASKHLL ON
; Probe.ARM

; --------------------------------------------------------------------------------

print "end"

ENDDO



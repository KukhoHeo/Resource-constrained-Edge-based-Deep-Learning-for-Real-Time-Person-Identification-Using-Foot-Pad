;
; Copyright (c) 2009 Sung Ho Park
;
; SPDX-License-Identifier: Apache-2.0
;

; --------------------------------------------------------------------------------

print "begin"

; --------------------------------------------------------------------------------
; initialize and start the debugger

RESet
SYStem.RESet
SYStem.CPU NRF52832QFAA
SYStem.CONFIG.DEBUGPORTTYPE SWD
IF hardware.COMBIPROBE()||hardware.UTRACE()
(
  SYStem.CONFIG.CONNECTOR MIPI20T
)
SYStem.Option DUALPORT ON
SYStem.MemAccess DAP
SYStem.JtagClock CTCK 10MHz
SYStem.Up

; --------------------------------------------------------------------------------
; Flash programming

; prepare flash programming (declarations)
&flashsize=0x80000
&pagesize=0x1000

FLASH.RESet
FLASH.Create 1. 0x00000000++(&flashsize-1) &pagesize TARGET Long
FLASH.Create 2. 0x10001000++0x0FFF &pagesize NOP Long  ; UICR area

FLASH.TARGET 0x20000000 0x20001000 0x800 ~~~~/flash_writer.elf

; ReProgram Flash
FLASH.ReProgram 0x00000000++0x00025FFF
Data.LOAD.IntelHex ~~~~/nrf52_softdevice.hex
FLASH.ReProgram OFF
FLASH.ReProgram 0x00026000++0x0005A000
Data.LOAD.Elf ~~~~/app.elf
FLASH.ReProgram OFF

; --------------------------------------------------------------------------------

Register.Set PC 0x00000A81

Break.Set main
Mode.Hll
SYStem.Option.IMASKASM ON
SYStem.Option.IMASKHLL ON
; Probe.ARM

; --------------------------------------------------------------------------------

print "end"

ENDDO



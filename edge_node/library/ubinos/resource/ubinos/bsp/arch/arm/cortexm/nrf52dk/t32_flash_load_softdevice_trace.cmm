;
; Copyright (c) 2009 Sung Ho Park
;
; SPDX-License-Identifier: Apache-2.0
;

; --------------------------------------------------------------------------------

print "begin"

; --------------------------------------------------------------------------------
; initialize and start the debugger

RESet
SYStem.RESet
SYStem.CPU NRF52832QFAA
SYStem.CONFIG.DEBUGPORTTYPE SWD
IF hardware.COMBIPROBE()||hardware.UTRACE()
(
  ; The trace was tested on a  nRF52 Development Kit without trace signals on a debug header.
  ; To test the trace a test adapter has used, that maps the trace signals according to the
  ; MIPI34 spec.
  SYStem.CONFIG.CONNECTOR MIPI34
)
SYStem.Option DUALPORT ON
SYStem.MemAccess DAP
SYStem.JtagClock CTCK 10MHz
SYStem.Up

; --------------------------------------------------------------------------------
; Setup pin multiplexing for parallel trace.
Data.Set AD:0x4000055C %Long 0x00020000    ; Set CLOCK.TRACECONFIG.TRACEMUX to Parallel
; Inclease driver strength GPIO.PIN_CNF[x].DRIVE = H0H1
Data.Set AD:0x50000738 %Long 0x00000303    ; Port 14 (TRACEDATA3)
Data.Set AD:0x5000073C %Long 0x00000303    ; Port 15 (TRACEDATA2)
Data.Set AD:0x50000740 %Long 0x00000303    ; Port 16 (TRACEDATA1)
Data.Set AD:0x50000748 %Long 0x00000303    ; Port 18 (TRACEDATA0)
Data.Set AD:0x50000750 %Long 0x00000303    ; Port 20 (TRACECLK)

; --------------------------------------------------------------------------------
; initialize offchip-trace (ETM ON, ITM ON)
IF hardware.COMBIPROBE()||hardware.UTRACE()||Analyzer()
(
  ; set PinMux and enable Clocks

  TPIU.PortSize 4
  TPIU.PortMode Continuous
  ITM.DataTrace CorrelatedData
  ITM.ON
  ETM.Trace ON
  ETM.ON
)
IF hardware.COMBIPROBE()||hardware.UTRACE()
(
  Trace.METHOD CAnalyzer
  Trace.AutoInit ON
  IF VERSION.BUILD.BASE()>=74752.
  (
    CAnalyzer.AutoFocus
  )
  ELSE
  (
    ; for uTrace & Combiprobe use manual calibration
    ; CAnalyzer.ClockDELAY Large
  )
)
IF Analyzer()
(
  Trace.METHOD Analyzer
  Trace.AutoInit ON
  Trace.AutoFocus
)

; --------------------------------------------------------------------------------
; Flash programming

; prepare flash programming (declarations)
&flashsize=0x80000
&pagesize=0x1000

FLASH.RESet
FLASH.Create 1. 0x00000000++(&flashsize-1) &pagesize TARGET Long
FLASH.Create 2. 0x10001000++0x0FFF &pagesize NOP Long  ; UICR area

FLASH.TARGET 0x20000000 0x20001000 0x800 ~~~~/flash_writer.elf

; ReProgram Flash
FLASH.ReProgram 0x00000000++0x00025FFF
Data.LOAD.IntelHex ~~~~/nrf52_softdevice.hex
FLASH.ReProgram OFF
FLASH.ReProgram 0x00026000++0x0005A000
Data.LOAD.Elf ~~~~/app.elf
FLASH.ReProgram OFF

; --------------------------------------------------------------------------------

Register.Set PC 0x00000A81

Break.Set main
Mode.Hll
SYStem.Option.IMASKASM ON
SYStem.Option.IMASKHLL ON
; Probe.ARM

; --------------------------------------------------------------------------------

print "end"

ENDDO



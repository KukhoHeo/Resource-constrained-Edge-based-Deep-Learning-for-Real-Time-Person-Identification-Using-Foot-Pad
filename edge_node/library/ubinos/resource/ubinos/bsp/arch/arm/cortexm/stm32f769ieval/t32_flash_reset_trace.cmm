;
; Copyright (c) 2009 Sung Ho Park
;
; SPDX-License-Identifier: Apache-2.0
;

; --------------------------------------------------------------------------------

print "begin"

; --------------------------------------------------------------------------------
; initialize and start the debugger

RESet
SYStem.RESet
SYStem.CPU STM32F769NI
SYStem.CONFIG.DEBUGPORTTYPE SWD
IF hardware.COMBIPROBE()||hardware.UTRACE()
(
  SYStem.CONFIG.CONNECTOR MIPI20T
)
SYStem.Option DUALPORT ON
SYStem.MemAccess DAP
SYStem.JtagClock CTCK 10MHz
Trace.TraceCLOCK 100.0MHz
Trace.DISable
SYStem.Up

; --------------------------------------------------------------------------------
; initialize OFFCHIP trace (ETM, ITM)
IF COMBIPROBE()||UTRACE()||Analyzer()
(
  ; set PinMux and enable Clocks
  Data.Set AD:0xe0042004 %Long Data.Long(E:0xe0042004)|0xe0 ; DBGMCU_CR
  ; set PinMux for PE2-6 -AF0
  Data.Set AD:0x40023810 %Long Data.Long(E:0x40023810)&~0x10      ; RCC_AHB1RST
  Data.Set AD:0x40023830 %Long Data.Long(E:0x40023830)|0x10       ; RCC_AHB1ENR
  Data.Set AD:0x40021000 %Long Data.Long(E:0x40021000)|0x00002aa0 ; GPIOE_MODER
  Data.Set AD:0x40021008 %Long Data.Long(E:0x40021008)|0x00003ff0 ; GPIOE_OSPEEDR
  Data.Set AD:0x40021020 %Long Data.Long(E:0x40021020)&0xf00000ff ; GPIOE_AFRL

  TPIU.PortSize 4
  TPIU.PortMode Continuous
  ITM.DataTrace CorrelatedData
  ITM.ON
  ETM.Trace ON
  ETM.ON
)
IF COMBIPROBE()||UTRACE()
(
  Trace.METHOD CAnalyzer
  Trace.AutoInit ON
  IF CAnalyzer.FEATURE(TPIU.TERMINATION)
  (
    ; pins have limited output current with low supply voltage -> disable Termination
    ;Trace.TERMination OFF
  )
;  Trace.AutoFocus
)
IF Analyzer()
(
  Trace.METHOD Analyzer
  Trace.AutoInit ON
  Trace.AutoFocus
)

; --------------------------------------------------------------------------------
; Load

Data.LOAD.Elf ~~~~/app.elf /nocode

; --------------------------------------------------------------------------------

Register.Set PC Reset_Handler

Break.Set main
Mode.Hll
SYStem.Option.IMASKASM ON
SYStem.Option.IMASKHLL ON
; Probe.ARM

; --------------------------------------------------------------------------------

print "end"

ENDDO


